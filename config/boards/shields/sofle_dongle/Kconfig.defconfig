## config/boards/shields/sofle_dongle/Kconfig.defconfig
```kconfig
if SHIELD_SOFLE_DONGLE

config ZMK_KEYBOARD_NAME
    default "SOFLE"

config ZMK_SPLIT_ROLE_CENTRAL
    default y

endif

if SHIELD_SOFLE_LEFT || SHIELD_SOFLE_RIGHT || SHIELD_SOFLE_DONGLE

config ZMK_SPLIT
    default y

config ZMK_BLE
    default y

endif
```
